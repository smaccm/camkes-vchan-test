## apps/vchan-test-aadl/Kconfig
```kconfig
#
# Copyright 2014, NICTA
#
# This software may be distributed and modified according to the terms of
# the GNU General Public License version 2. Note that NO WARRANTY is provided.
# See "LICENSE_GPLv2.txt" for details.
#
# @TAG(NICTA_GPL)
#

menuconfig APP_CAMKES_VCHANTEST_AADL
    bool "Vchan and AADL test application"
    default n
    help 
        VChan and AADL Test application.
```

## apps/vchan-test/Kconfig
```kconfig
#
# Copyright 2014, NICTA
#
# This software may be distributed and modified according to the terms of
# the GNU General Public License version 2. Note that NO WARRANTY is provided.
# See "LICENSE_GPLv2.txt" for details.
#
# @TAG(NICTA_GPL)
#

menuconfig APP_CAMKES_VCHANTEST
    bool "Simple Vchan test application"
    default n
    help 
        Simple VChan Client and Server Test application without VM.
```
